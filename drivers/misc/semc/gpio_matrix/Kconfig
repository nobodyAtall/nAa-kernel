## drivers/misc/semc/gpio_matrix/Kconfig
```kconfig
comment "SEMC GPIO DRIVERS"

config SEMC_GPIO_MATRIX_DRIVER
        bool "Semc gpio matrix"
        default n
        help
          Modified gpio matrix driver that supports additional filtering

config SEMC_GPIO_INPUT_DRIVER
        bool "Semc gpio input"
        default n
        help
          Modified gpio input driver that supports additional processing

config SEMC_GPIO_EXTR
        bool "SEMC GPIO Extractor"
        default n
        help
          Platform/Product specific SEMC GPIO extractor (get/set interface)
```

## drivers/misc/semc/power/Kconfig
```kconfig
comment "SEMC Power implementation"

config SEMC_POWER_BOOTLOADER_INITIATES_CHARGING
	bool "Boot loader is setting up the charger"
	depends on SEMC_POWER
	default y
	help
	  The bootloader that starts the SW is initiating the charging.
	  When charging is already active upon probing of this driver
	  the charger voltage and current is not allowed to be changed until
	  values are communicated from platform.
	  This prevents power cut of the platform at low voltage levels.

config SEMC_POWER_BQ24180
       bool "BQ24180 charger HW"
       depends on SEMC_POWER && I2C
       default y
       help
         The charging is done by BQ24180
```

## drivers/misc/semc/seport/Kconfig
```kconfig
comment "SEMC Systemconnector implementation"

config SEMC_SEPORT
        tristate "Semc systemconnector"
	select SEMC_SEPORT_PLATFORM
        default n
        help
          Enable semc systemconnector. If built as module, will be called
          semc_systemconnector.ko. Requires the hardware specific driver
	  config SEMC_SEPORT_PLATFORM which will automatically be anabled
	  by this selection.

config SEPORT_VIDEO_OUT
	bool "Hardware has support for video out"
	depends on SEMC_SEPORT
	default n
	help
	 This enables Video out support in the systemconnector.
	 Only enable this if required.
	 If unsure, say N
```

## drivers/misc/semc/simcdetect/Kconfig
```kconfig
comment "SIM card detect driver"

config MSM_SIM_CARD_DETECT
	bool "SIM card detect driver"
	default n
	help
	  This option enables sim card detect driver
```

## drivers/misc/semc/vibrator/Kconfig
```kconfig
comment "SEMC vibrator driver for msm-pmic platform"

config SEMC_MSM_PMIC_VIBRATOR
        tristate "Semc msm pmic vibrator"
        default y
		select semcclass
		depends on (ARCH_MSM7X27 || ARCH_QSD8X50)
		help
          Vibrator driver for msm pmic platform
          msm-pmic-vibrator.ko
```

## drivers/mmc/core/Kconfig
```kconfig
#
# MMC core configuration
#

config MMC_UNSAFE_RESUME
	bool "Allow unsafe resume (DANGEROUS)"
	help
	  If you say Y here, the MMC layer will assume that all cards
	  stayed in their respective slots during the suspend. The
	  normal behaviour is to remove them at suspend and
	  redetecting them at resume. Breaking this assumption will
	  in most cases result in data corruption.

	  This option is usually just for embedded systems which use
	  a MMC/SD card for rootfs. Most people should say N here.

config MMC_AUTO_SUSPEND
	bool "Enable auto suspend feature"
	depends on PM && MMC_UNSAFE_RESUME && EXPERIMENTAL
	default n
	help
	  If you say Y here, it allows MMC core to provide an interface for
	  the host drivers to register a callback that the core will call if
	  the MMC bus is idle for a certain amount of time.

	  The idle timeout is run-time configurable via sysfs interface. A
	  module paramter "idle_timeout" is also provided to configure the
	  value through kernel command-line. The default value is set to 20 sec.

	  This feature is supported only for SD/MMC cards.

config MMC_EMBEDDED_SDIO
	boolean "MMC embedded SDIO device support (EXPERIMENTAL)"
	depends on EXPERIMENTAL
	help
	  If you say Y here, support will be added for embedded SDIO
	  devices which do not contain the necessary enumeration
	  support in hardware to be properly detected.

config MMC_PARANOID_SD_INIT
	bool "Enable paranoid SD card initialization (EXPERIMENTAL)"
	depends on EXPERIMENTAL
	help
	  If you say Y here, the MMC layer will be extra paranoid
	  about re-trying SD init requests. This can be a useful
	  work-around for buggy controllers and hardware. Enable
	  if you are experiencing issues with SD detection.
```

## drivers/oc_robyn/Kconfig
```kconfig
#
# X10MINIOC module configuration
#

config ROBYN_OVERCLOCK
	tristate "Robyn overclock"
	help
	  Say Y here if you want to build an overclocking module for X10mini

	  If unsure, say N.

	  To compile this module, choose M here: the
	  module will be called x10minioc.
```

## drivers/oc_shakira/Kconfig
```kconfig
#
# X8OC module configuration
#

config SHAKIRA_OVERCLOCK
	tristate "Shakira overclock"
	help
	  Say Y here if you want to build an overclocking module for X8

	  If unsure, say N.

	  To compile this module, choose M here: the
	  module will be called x8oc.
```

## drivers/oc_x10_mini/Kconfig
```kconfig
#
# X10MINIOC module configuration
#

config X10_MINI_OVERCLOCK
	tristate "X10mini overclock"
	help
	  Say Y here if you want to build an overclocking module for X10mini

	  If unsure, say N.

	  To compile this module, choose M here: the
	  module will be called x10minioc.
```

## drivers/uv_mimmi/Kconfig
```kconfig
#
# X10miniproUV module configuration
#

config MIMMI_UNDERVOLT
	tristate "Mimmi undervolt"
	help
	  Say Y here if you want to build an undervolt module for X10minipro

	  If unsure, say N.

	  To compile this module, choose M here: the
	  module will be called x10miniprouv.
```

## drivers/uv_robyn/Kconfig
```kconfig
#
# X10miniUV module configuration
#

config ROBYN_UNDERVOLT
	tristate "Robyn undervolt"
	help
	  Say Y here if you want to build an undervolt module for X10mini

	  If unsure, say N.

	  To compile this module, choose M here: the
	  module will be called x10miniuv.
```

## drivers/uv_shakira/Kconfig
```kconfig
#
# Shakira module configuration
#

config SHAKIRA_UNDERVOLT
	tristate "Shakira undervolt"
	help
	  Say Y here if you want to build an undervolt module for X8

	  If unsure, say N.

	  To compile this module, choose M here: the
	  module will be called x8uv.
```

## drivers/uv_x10_mini/Kconfig
```kconfig
#
# X10miniUV module configuration
#

config X10_MINI_UNDERVOLT
	tristate "X10mini undervolt"
	help
	  Say Y here if you want to build an undervolt module for X10mini

	  If unsure, say N.

	  To compile this module, choose M here: the
	  module will be called x10miniuv.
```
